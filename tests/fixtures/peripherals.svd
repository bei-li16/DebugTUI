# TestDevice register map
File version: 1
Register reader fixture
CPU: CM4 r0p0, little endian, no MPU, no FPU, 4 interrupt priority bits
Registers are 32-bit, read-write, no defined reset value unless marked. A register's access mark holds for its fields unless they carry their own. Offsets are from the block's base; lines under a group give offsets from that group; [hi:lo] are bit positions; {n}, {i} and the like mark numbered series; 'fields as' and 'values as' point back to an identical list; <NAME> marks a mode.

## Memory map
0x40000000 PORT — Test port
0x40001000 PORT2

## PORT — Test port
Base 0x40000000
Same registers: PORT2 0x40001000
0x00 DATA
  [7:0] LOW
0x04 WO wo
0x08 CLEAR read-clears
0x0C FIELD_CLEAR
  [0] FLAG read-clears
{0x20+0x10*i} CH{i} (i=0..1) group
  {0x0+4j} VALUE{j} (j=0..1) 16-bit
